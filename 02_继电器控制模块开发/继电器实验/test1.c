/*******************************************************************************
 * 文件名称：uart2.c
 * 功    能：CC253x系列片上系统基础实验 ---单片机串口发数
 * 描    述：本实验使用CC253x系列片上系统的片内USART控制器，工作在UART模式下，
             在PC 上从串口向CC2530 模块发送命令，单片机通过UART0中断接收方式，
             即可控制LED灯的亮灭.实验使用 CC2530 的串口 1，波特率为 57600。
 * 实验硬件： 
 *           用USB电缆连接SK-SmartRF05EB上的USB接口与用户PC的USB接口。

 * 作    者：HJL
 * 日    期：2012-8-14
 ******************************************************************************/
/* 包含头文件 */
/********************************************************************/
#include "ioCC2530.h"  // 引用头文件,包含对CC2530的寄存器、中断向量等的定义
#include <string.h>
/********************************************************************/
//定义led灯端口
#define JD P2_0    // P2_0定义为P2.0
#define LED P1_0

#define ON 1          //定义开继电器
#define OFF 0         //定义关继电器

#define uint unsigned int 
#define uchar unsigned char
#define DATABUFF_SIZE 3  //数据缓冲区大小

uchar buff[DATABUFF_SIZE]; //数据缓冲区
uint uIndex = 0;  //数据缓冲区的下标

/*********************************************************************
 * 函数名称：InitUART0
 * 功    能：UART0初始化
 *           P0.2  RX                  
 *           P0.3  TX
 *           波特率：57600
 *           数据位：8
 *           停止位：1
 *           奇偶校验：无
 * 入口参数：无
 * 出口参数：无
 * 返 回 值：无
 ********************************************************************/
/*******************************************************************/
void init_LED()
{
     P2SEL&= ~0x01;     // 设置继电器出口为普通IO口 1111 1110
     P2DIR|= 0x01 ;    // 设置继电器引脚控制端为输出0000 0010
     JD = 0;               
}
/******************************************************************/
void initUART0(void)
{
   
  /* 片内外设引脚位置采用上电复位默认值，即PERCFG寄存器采用默认值 */
    PERCFG = 0x00;	//位置 1 P0 口     
    /* UART0相关引脚初始化 
       P0.2——RX，      P0.3——TX      P0.4——CT，      P0.5——RT   */     
    P0SEL = 0x3c;	//P0 用作串口, P0.2、P0.3、P0.4、P0.5作为片内外设I/O
  
     
  /* P0口外设优先级采用上电复位默认值，即P2DIR寄存器采用默认值 */
  /* 第一优先级：USART0
     第二优先级：USART1
     第三优先级：Timer1   */
    
  /* UART0波特率设置 */
  /* 波特率：38400   
     当使用32MHz 晶体振荡器作为系统时钟时，要获得57600波特率需要如下设置：
         UxBAUD.BAUD_M = 216
         UxGCR.BAUD_E = 10
         该设置误差为0.03%
   */
  U0BAUD = 59;
  U0GCR = 10;
  
  /* USART模式选择 */
  U0CSR |= 0x80;  // UART模式
  
  /* UART0配置 ，以下配置参数采用上电复位默认值：
         硬件流控：无
         奇偶校验位(第9位)：奇校验
         第9位数据使能：否
         奇偶校验使能：否
         停止位：1个
         停止位电平：高电平
         起始位电平：低电平
   */
   U0UCR |= 0x80;  // 进行USART清除,并设置数据格式为默认值    
   URX0IF = 0;          // 清零UART0 RX中断标志
   U0CSR |= 0X40;	//允许接收
  
   URX0IE = 1;             // 使能UART0 RX中断 
   EA = 1;   //使能全局中断
}


/*********************************************************************
 * 函数名称：receive_handler
 * 功    能：接收数据后处理
 * 入口参数：无
 * 出口参数：无
 * 返 回 值：无
 ********************************************************************/

void receive_handler(void)
{
  uchar c;
  c= U0DBUF;         // 读取接收到的字节 
  buff[uIndex] =c;
  if(c=='#'&&uIndex>=DATABUFF_SIZE-1)  //#表示字符串的结束符
  {
    switch(buff[uIndex-1])
    {
    case '1':            //11# 第一位的1表示继电器1(如果有多个继电器)第二位表示状态 1：表示开 0：表示关
           JD=ON;
           LED=1;
          break;
    case '0':
          JD=OFF;
          LED=0;
          break;
    
    }
    for(int i=0;i<=uIndex;i++)     //清空数组内信息，即清空接收到的字符串
        buff[i]=(uchar)NULL;
     uIndex = 0;
  }
  else  uIndex++;  // 累计接收到的字节计数加1 
}


/*********************************************************************
 * 函数名称：URX0_ISR
 * 功    能：UART0 RX中断服务函数
 * 入口参数：无
 * 出口参数：无
 * 返 回 值：无
 ********************************************************************/
#pragma vector=URX0_VECTOR     //中断向量表的设置
__interrupt void URX0_ISR(void)
{
  URX0IF = 0;//清中断标志
  receive_handler();  //调用接收数据后处理函数
}



/*********************************************************************
 * 函数名称：main
 * 功    能：main函数入口
 * 入口参数：无
 * 出口参数：无
 * 返 回 值：无
 ********************************************************************/
void main(void)
{  
  P1SEL&=~0X01;
  P1DIR|=0X01;
  LED=0;
   CLKCONCMD &= 0x80;  //时钟速度设置为32MHz  
   init_LED();    //LED端口初始化
   initUART0();  // UART0初始化  
   while(1) ;
  
}