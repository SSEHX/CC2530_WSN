/*******************************************************************************
 * 文件名称：WDTAsWD_Ex.c
 * 功    能：CC253x系列片上系统基础实验--- 看门狗定时器作为看门狗
 * 描    述：让看门狗定时器工作在看门狗模式，超时时间为1s（即到达1s之前还没喂狗
 *           就产生复位）。若喂狗，则LED灯一直亮，若不喂狗LED1间隔为1s不断闪烁
 *           
 * 作    者：HJL
 * 日    期：2012-9-10
 ******************************************************************************/
/* 包含头文件 */
/********************************************************************/
#include "ioCC2530.h"    // CC2530的头文件，包含对CC2530的寄存器、中断向量等的定义
/********************************************************************/
//定义led灯端口：p1.1
#define LED1 P1_0     // P1_0定义为P1.0

/*********************************************************************
 * 函数名称：delay
 * 功    能：软件延时
 * 入口参数：无
 * 出口参数：无
 * 返 回 值：无
 ********************************************************************/

void delay(unsigned int time)
{ unsigned int i;
  unsigned char j;
  for(i = 0; i < time; i++)
  {  for(j = 0; j < 240; j++)
      {   asm("NOP");    // asm是内嵌汇编，nop是空操作,执行一个指令周期
          asm("NOP");
          asm("NOP");
       }  
   }  
}

/*********************************************************************
 * 函数名称：systemClock_Init
 * 功    能：系统时钟初始化
 * 入口参数：无
 * 出口参数：无
 * 返 回 值：无
 ********************************************************************/
void systemClock_Init(void)
{
   unsigned char clkconcmd,clkconsta;
   CLKCONCMD &= 0x80;
 
  /* 等待所选择的系统时钟源(主时钟源)稳定 */
  clkconcmd = CLKCONCMD;             // 读取时钟控制寄存器CLKCONCMD
  do
  {
    clkconsta = CLKCONSTA;           // 读取时钟状态寄存器CLKCONSTA
  } while(clkconsta != clkconcmd);  // 直到选择的系统时钟源(主时钟源)已经稳定 
}


/*********************************************************************
 * 函数名称：led_Init
 * 功    能：LED初始化
 * 入口参数：无
 * 出口参数：无
 * 返 回 值：无
 ********************************************************************/
void led_Init(void)
{
  P1SEL  = 0x00;              //P1为普通 I/O 口
  P1DIR |= 0x01;              //P1.0输出  
   LED1 = 0;  // 灭LED1  
  
}


/*********************************************************************
 * 函数名称：watchdog_Init
 * 功    能：看门狗初始化
 * 入口参数：无
 * 出口参数：无
 * 返 回 值：无
 ********************************************************************/
void watchdog_Init(void)   
{
   WDCTL = 0x00;              //看门狗模式，时间间隔一秒
   WDCTL |= 0x08;             //启动看门狗
}


/*********************************************************************
 * 函数名称：FeedWD
 * 功    能：喂狗
 * 入口参数：无
 * 出口参数：无
 * 返 回 值：无
 ********************************************************************/
void FeedWD(void)
{
  WDCTL |= 0xA0;
  WDCTL |= 0x50;
}


/*********************************************************************
 * 函数名称：main
 * 功    能：main函数入口
 * 入口参数：无
 * 出口参数：无
 * 返 回 值：无
 ********************************************************************/

void main(void)
{
  systemClock_Init();  
  led_Init();
  watchdog_Init();
  delay(30000);     //延时小于1秒。读者可以想一下，若大于1秒，会出现什么情况 
  LED1 =1;          //亮LED1  
  while(1)
  {
    FeedWD();      //喂狗指令（加入后系统不复位，小灯不闪烁；若注释，则系统不断复位，小灯每隔1s闪烁一次）
  }
}