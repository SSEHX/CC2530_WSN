/*******************************************************************************
  * 文件名称：interrupt.c
  * 功    能：CC253x系列片上系统基础实验--- 外部中断
 * 描    述：使用P0口的外部中断功能。开始四盏灯全灭，当第一次点按"SW1"键，
             LED1灯亮；而后每点按"SW1"键一次，LED灯亮的个数加1；当四盏灯
             全亮时，再次点按"SW1"键，则四盏灯全灭，重新回到初始状态.
 * 硬件连接： LED与CC253x的硬件连接关系如下：
 *                LED                          CC253x  
 *               LED1（D3）                       P1.0
 *               LED2（D4）                       P1.1
 *               LED3（D5）                       P1.3
 *               LED4（D6）                       P1.4
                  SW1                             P1.2
 * 作    者：HJL
 * 日    期：2012-8-14
 ******************************************************************************/
/* 包含头文件 */
/********************************************************************/
#include "ioCC2530.h"  // 引用头文件,包含对CC2530的寄存器、中断向量等的定义
/********************************************************************/
//定义led灯端口：p1.3, p1.4：

#define LED1 P1_0     // P1_0定义为P1.0
#define LED2 P1_1     // P1_1定义为P1.1
#define LED3 P1_3     // P1_3定义为P1.3
#define LED4 P1_4     // P1_4定义为P1.4
#define SW1  P1_2     // P1_2定义为SW1

unsigned int KeyTouchtimes = 0 ; //定义变量记录按键次数

/*********************************************************************
* 函数名称：delay
 * 功    能：软件延时
 * 入口参数：无
 * 出口参数：无
 * 返 回 值：无
 ********************************************************************/
void delay(unsigned int time)
{ unsigned int i;
  unsigned char j;
  for(i = 0; i < time; i++)
  {  for(j = 0; j < 240; j++)
      {   asm("NOP");    // asm是内嵌汇编，nop是空操作,执行一个指令周期
          asm("NOP");
          asm("NOP");
       }  
   }  
}

/*********************************************************************
 * 函数名称：init
 * 功    能：初始化系统IO,定时器T1控制状态寄存器
 * 入口参数：无
 * 出口参数：无
 * 返 回 值：无
 ********************************************************************/
void init()
{    P1SEL &= ~0x1F;     // 设置LED1、SW1为普通IO口
     P1DIR |= 0x1B ;    // 设置LED1为输出
     P1DIR &= ~0X04;	//Sw1按键在 P1.2,设定为输入
     LED1 = 0;         //灭 LED
     LED2 = 0;        
     LED3 = 0;         
     LED4 = 0;  
       
     PICTL &= ~0x02;  //配置P1口的中断边沿为上升沿产生中断
     P1IEN |= 0x04;  //使能P1.2中断
     IEN2 |= 0x10;  //使能P1口中断    
    
     EA = 1;   //使能全局中断
}


/*********************************************************************
 * 函数名称：EINT_ISR
 * 功    能：外部中断服务函数
 * 入口参数：无
 * 出口参数：无
 * 返 回 值：无
 ********************************************************************/
#pragma vector=P1INT_VECTOR
__interrupt void EINT_ISR(void)
{
    EA = 0;           // 关闭全局中断
   /* 若是P1.2产生的中断 */
    if(P1IFG & 0x04)
    { 
        /* 等待用户释放按键，并消抖 */
       while(SW1 == 0);    //低电平有效
       delay(100);
       while(SW1 == 0);  
       
       KeyTouchtimes = KeyTouchtimes+1; //每次中断发生时记录按键次数加1       
       /* 清除中断标志 */
       P1IFG &= ~0x04;   // 清除P1.2中断标志      
    }
    EA = 1;          // 使能全局中断 
}



/*********************************************************************
 * 函数名称：main
 * 功    能：main函数入口
 * 入口参数：无
 * 出口参数：无
 * 返 回 值：无
 ********************************************************************/
void main(void)
{  
   init();   //调用初始化函数
   while(1) 
   { if(KeyTouchtimes ==1) //1盏灯亮
     {
        LED1 = 1;     
     }
    else if(KeyTouchtimes == 2) //2盏灯亮
     {
        LED2=1;
     }
    else if(KeyTouchtimes == 3) //三盏灯全亮
     { LED3=1;   }
   
    else if(KeyTouchtimes == 4) //三盏灯全亮
     { LED4=1;   }     
    else if(KeyTouchtimes == 5) //全部灯灭
     {   LED1 = 0;         //灭 LED
         LED2 = 0;        
         LED3 = 0;         
         LED4 = 0; 
        KeyTouchtimes =0; //重置按键次数记录变量
      }
   }
}


