/* 包含头文件 */
/********************************************************************/
#include "ioCC2530.h"  // 引用头文件,包含对CC2530的寄存器、中断向量等的定义
//#include <string.h>
/********************************************************************/
//定义led灯端口
#define LED1 P1_0     // P1_0定义为P1.0

typedef unsigned short uint16;
typedef unsigned long uint32;
typedef unsigned int uint;

unsigned int flag,counter=0; //统计溢出次数



char s[6];//定义一个数组大小为6
/******************************************************************/
void InitLED()
{
  P1SEL&=~0X01;           //P1.0设置为普通的IO口   1111 1110  
  P1DIR |= 0x01;   /* 配置P1.0的方向为输出 */ 
  LED1=0;
}
/*****************************************************/
void hal_adc_Init(void)
{
	APCFG  |=1;   
        P0SEL  |= (1 << (0));	
        P0DIR  &= ~(1 << (0));	
    
}
/******************************************************************************
 * 名称       get_adc
 * 功能       读取A/D值
 * 入口参数   无
 * 出口参数   16位电压值，分辨率为10mV, 如0x0102表示2.58V
 *****************************************************************************/
uint16 get_adc(void)
{
   uint32 value;
   hal_adc_Init(); // ADC初始化
   ADCIF = 0;   //清ADC 中断标志
   //采用基准电压avdd5:3.3V，通道0，启动AD转化
   ADCCON3 = (0x80 | 0x10 | 0x00);
   while ( !ADCIF )
   {
       ;  //等待AD转化结束
   }
   value = ADCH;
   value = value<< 8;
   value |= ADCL;
  // AD值转化成电压值
  // 0 表示 0V ，32768 表示 3.3V
  // 电压值 = (value*3.3)/32768 （V)
  value = (value * 330);
  value = value >> 15;   // 除以32768
  // 返回分辨率为0.01V的电压值
  return (uint16)value;
}
/**************串口通信初始化*************************************/
void initUART0(void)
{
    PERCFG = 0x00;	//位置 1 P0 口     
    P0SEL = 0x3c;	

  /* UART0波特率设置 */
  /* 波特率：38400 */
  U0BAUD = 59;
  U0GCR = 10;
 
  U0CSR |= 0x80;  // UART模式
  U0UCR |= 0x80;  // 进行USART清除
   UTX0IF = 0;  // 清零UART0 TX中断标志
   EA = 1;   //使能全局中断
}

/*********************************************************************
 * 函数名称：inittTimer1
 * 功    能：初始化定时器T1控制状态寄存器
 * 入口参数：无
 * 出口参数：无
 * 返 回 值：无
 *********************定时器初始化**************************************/
void inittTimer1()
{  
 
  /* 配置定时器1的16位计数器的计数频率,定时0.2S，计数10次，即2S发一次数据
       Timer Tick    分频    定时器1的计数频率   T1CC0的值   时长    
       32MHz         /128       250KHz              50000     0.2s   */
   
      CLKCONCMD &= 0x80;   //时钟速度设置为32MHz    
      T1CTL = 0x0E;      // 配置128分频，模比较计数工作模式，并开始启动     
      T1CCTL0 |= 0x04;  //设定timer1通道0比较模式
      T1CC0L =50000 & 0xFF;               // 把50000的低8位写入T1CC0L
      T1CC0H = ((50000 & 0xFF00) >> 8);   // 把50000的高8位写入T1CC0H 
      
      T1IF=0;           //清除timer1中断标志(同IRCON &= ~0x02)
      T1STAT &= ~0x01;  //清除通道0中断标志
      
      TIMIF &= ~0x40;  //不产生定时器1的溢出中断
      //定时器1的通道0的中断使能T1CCTL0.IM默认使能
      IEN1 |= 0x02;    //使能定时器1的中断  
      EA = 1;        //使能全局中断 
}

/*********************************************************************
 * 函数名称：UART0SendByte
 * 功    能：UART0发送一个字节
 * 入口参数：c
 * 出口参数：无
 * 返 回 值：无
 ********************************************************************/
void UART0SendString(char *Data,int len)
{
  uint i;
  for(i=0;i<len;i++)
  {
    U0DBUF=*Data++;
    while(UTX0IF==0);
    UTX0IF=0;
  }
}
/**************获取电压值并处理数据*************************************/
void Get_val()
{
         uint16 sensor_val;
         sensor_val=get_adc();
         s[0]=sensor_val/100+'0';
         s[1]='.';
         s[2]=sensor_val/10%10+'0';
         s[3]=sensor_val%10+'0';
         s[4]='V';
         s[5]='\n'; 
}
/*********************************************************************
 * 功    能：定时器T1中断服务子程序
 ********************************************************************/
#pragma vector = T1_VECTOR //中断服务子程序
__interrupt void T1_ISR(void) 
  { 
    EA = 0;   //禁止全局中断
    counter++; 
    if(counter>=10)     //每0.2S发一次字符串
     { counter=0;       //清标志位
      LED1 = !LED1;    //指示灯
      flag=1;
     }
    T1STAT &= ~0x01;  //清除通道0中断标志
    EA = 1;   //使能全局中断    
}
/*********************************************************************
 * 函数名称：main
 * 功    能：main函数入口
 * 入口参数：无
 * 出口参数：无
 * 返 回 值：无
 ********************************************************************/
void main(void)
{  
   InitLED();
   inittTimer1();  //初始化Timer1
   initUART0();  // UART0初始化  
   while(1)
   {
     if(flag==1)
      {
          flag=0;
          Get_val();
          UART0SendString("光照传感器电压值        ",17);
          UART0SendString(s,6);
      }
   } 
}