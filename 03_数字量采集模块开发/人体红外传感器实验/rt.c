/*******************************************************************************
  * 文件名称：uart1.c
 * 功    能：CC253x系列片上系统基础实验 ---单片机串口发数
 * 描    述：实现从 CC2530 上通过串口每2秒发送字串"UART0发送数据""，在PC端实验
            串口助手来接收数据。实验使用 CC2530 的串口 1，波特率为 38400。
 * 硬件连接： LED与CC253x的硬件连接关系如下：
 *                LED                          CC253x  
 *               LED1（D3）                       P1.0
 *               LED2（D4）                       P1.1
 *               LED3（D5）                       P1.3
 *               LED4（D6）                       P1.4
                  SW1                             P1.2
 * 作    者：HJL
 * 日    期：2012-8-14
 ******************************************************************************/
/* 包含头文件 */
/********************************************************************/
#include "ioCC2530.h"  // 引用头文件,包含对CC2530的寄存器、中断向量等的定义
/********************************************************************/
//定义led灯端口
#define LED1 P1_0     // P1_0定义为P1.0
#define RT_PIN P0_1   //人体红外传感器的输入引脚

unsigned int RT,counter=0; //统计溢出次数

/******************获取人体红外传感器信号*************************/
unsigned int get_swsensor()
{
    P0SEL&=~0X02;  //这里要设为普通IO 0为普通IO 1为外设 1111 1101 
    P0DIR&=0X02;   //设为输入 0为IO输入模式 1为输出模式 1111 1101
    return RT_PIN;
}
/******************************************************************/
void InitLED()
{
  P1SEL&=~0X01;           //1111 1110  
  P1DIR |= 0x01;   /* 配置P1.0的方向为输出 */ 
}
/**************串口通信初始化**************************************
 * 函数名称：InitUART0
 * 功    能：UART0初始化
 *           P0.2  RX                  
 *           P0.3  TX
 *           波特率：38400
 *           数据位：8
 *           停止位：1
 *           奇偶校验：无
 * 入口参数：无
 * 出口参数：无
 * 返 回 值：无
 ********************************************************************/
void initUART0(void)
{
  /* 片内外设引脚位置采用上电复位默认值，即PERCFG寄存器采用默认值 */
    PERCFG = 0x00;	//位置 1 P0 口     
    /* UART0相关引脚初始化 
       P0.2——RX，      P0.3——TX      P0.4——CT，      P0.5——RT   */     
    P0SEL = 0x3c;	//P0 用作串口, P0.2、P0.3、P0.4、P0.5作为片内外设I/O

  /* UART0波特率设置 */
  /* 波特率：38400 */
  U0BAUD = 59;
  U0GCR = 10;
 
  U0CSR |= 0x80;  // UART模式
  U0UCR |= 0x80;  // 进行USART清除
   UTX0IF = 0;  // 清零UART0 TX中断标志
   EA = 1;   //使能全局中断
}

/*********************************************************************
 * 函数名称：inittTimer1
 * 功    能：初始化定时器T1控制状态寄存器
 * 入口参数：无
 * 出口参数：无
 * 返 回 值：无
 *********************定时器初始化**************************************/
void inittTimer1()
{  
  /* 配置定时器1的16位计数器的计数频率,定时0.2S，计数10次，即2S发一次数据
       Timer Tick    分频    定时器1的计数频率   T1CC0的值   时长    
       32MHz         /128       250KHz              50000      0.2s  */  
   
      CLKCONCMD &= 0x80;   //时钟速度设置为32MHz    
      T1CTL = 0x0E;      // 配置128分频，模比较计数工作模式，并开始启动     
      T1CCTL0 |= 0x04;  //设定timer1通道0比较模式
      T1CC0L =50000 & 0xFF;               // 把50000的低8位写入T1CC0L
      T1CC0H = ((50000 & 0xFF00) >> 8);   // 把50000的高8位写入T1CC0H 
      
      T1IF=0;           //清除timer1中断标志(同IRCON &= ~0x02)
      T1STAT &= ~0x01;  //清除通道0中断标志
      
      TIMIF &= ~0x40;  //不产生定时器1的溢出中断
      //定时器1的通道0的中断使能T1CCTL0.IM默认使能
      IEN1 |= 0x02;    //使能定时器1的中断  
      EA = 1;        //使能全局中断 
}


/*********************************************************************
 * 函数名称：UART0SendByte
 * 功    能：UART0发送一个字节
 * 入口参数：c
 * 出口参数：无
 * 返 回 值：无
 ********************************************************************/
void UART0SendByte(unsigned char c)
{
  U0DBUF = c;       // 将要发送的1字节数据写入U0DBUF(串口 0 收发缓冲器)  
  while (!UTX0IF);  // 等待TX中断标志，即U0DBUF就绪
  UTX0IF = 0;       // 清零TX中断标志 
}


/*********************************************************************
 * 函数名称：UART0SendString
 * 功    能：UART0发送一个字符串
 * 入口参数：无
 * 出口参数：无
 * 返 回 值：无
 ********************************************************************/
void UART0SendString(unsigned char *str)
{
  while(1)
  {
    if(*str == '\0') break;  // 遇到结束符，退出
    UART0SendByte(*str++);   // 发送一字节
  } 
}
/*********************************************************************
 * 功    能：定时器T1中断服务子程序
 ********************************************************************/
#pragma vector = T1_VECTOR //中断服务子程序
__interrupt void T1_ISR(void) 
  { 
    EA = 0;   //禁止全局中断
    counter++; 
    RT=get_swsensor();  //取传感器值
    if(counter>=10)     //每0.2S发一次字符串
     { counter=0;       //清标志位
       LED1 = !LED1;    //指示灯
       if(RT!=1)
       {
           UART0SendString("有人\n");  // 从UART0发送字符串
       }else{
           UART0SendString("没有人\n"); 
       }
     }
  
    T1STAT &= ~0x01;  //清除通道0中断标志
    EA = 1;   //使能全局中断    
}


/*********************************************************************
 * 函数名称：main
 * 功    能：main函数入口
 * 入口参数：无
 * 出口参数：无
 * 返 回 值：无
 ********************************************************************/
void main(void)
{  
   InitLED();
   inittTimer1();  //初始化Timer1
   initUART0();  // UART0初始化  
   while(1) ; 
}